#include "roBa.dtsi"
#include <input/processors.dtsi>
#include <dt-bindings/zmk/input_transform.h>

/ {
    trackball_listener {
        status = "okay";
        compatible = "zmk,input-listener";
        device = <&trackball>;

        /* 通常マウス：サクサク + AML */
        input-processors = <
            &zip_xy_scaler 1 2
            &zip_aml 4 3000
        >;

        /* スクロールLayer(5)：縦優先＋横デッドゾーン */
        scroller {
            layers = <5>;
            input-processors = <
                &zip_xy_to_scroll_mapper
                &zip_scroll_transform (
                    INPUT_TRANSFORM_Y_INVERT |
                    INPUT_TRANSFORM_X_DEADZONE
                )
                &zip_scroll_scaler 1 12
            >;
        };
    };

    /* AML本体（除外なし＝右クリック安全） */
    zip_aml: zip_aml {
        compatible = "zmk,input-processor-temp-layer";
        #input-processor-cells = <2>;
    };
};
